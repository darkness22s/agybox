## configs/agybox_x86_64_defconfig
```kconfig
BR2_x86_64=y

# Small, self-contained musl userspace.
BR2_TOOLCHAIN_BUILDROOT_MUSL=y
BR2_TOOLCHAIN_BUILDROOT_CXX=y
BR2_KERNEL_HEADERS_6_12=y

# System identity and console-first startup.
BR2_TARGET_GENERIC_HOSTNAME="agybox"
BR2_TARGET_GENERIC_ISSUE="Welcome to Agy Box - disposable Linux sandbox\\n"
BR2_INIT_BUSYBOX=y
BR2_ROOTFS_OVERLAY="$(BR2_EXTERNAL_AGYBOX_PATH)/board/agybox/rootfs_overlay"
BR2_TARGET_GENERIC_ROOT_PASSWD=""
BR2_TARGET_GENERIC_GETTY=y
BR2_TARGET_GENERIC_GETTY_PORT="tty1"
BR2_TARGET_GENERIC_GETTY_BAUDRATE_115200=y
BR2_TARGET_GENERIC_GETTY_TERM="linux"

# Compressed RAM-root live image.
BR2_TARGET_ROOTFS_CPIO=y
BR2_TARGET_ROOTFS_CPIO_GZIP=y

# Linux kernel for broadly available x86-64 virtual and physical hardware.
BR2_LINUX_KERNEL=y
BR2_LINUX_KERNEL_CUSTOM_VERSION=y
BR2_LINUX_KERNEL_CUSTOM_VERSION_VALUE="6.12.99"
BR2_LINUX_KERNEL_USE_DEFCONFIG=y
BR2_LINUX_KERNEL_DEFCONFIG="x86_64"
BR2_LINUX_KERNEL_NEEDS_HOST_OPENSSL=y
BR2_LINUX_KERNEL_NEEDS_HOST_LIBELF=y

# Useful command-line development tools.
BR2_PACKAGE_BUSYBOX=y
BR2_PACKAGE_MAKE=y
BR2_PACKAGE_GIT=y
BR2_PACKAGE_PYTHON3=y
BR2_PACKAGE_PYTHON3_SSL=y
BR2_PACKAGE_CA_CERTIFICATES=y
BR2_PACKAGE_FILE=y
BR2_PACKAGE_TAR=y
BR2_PACKAGE_XZ=y
BR2_PACKAGE_GZIP=y
BR2_PACKAGE_BZIP2=y
BR2_PACKAGE_NANO=y
BR2_PACKAGE_UTIL_LINUX=y
BR2_PACKAGE_UTIL_LINUX_MOUNT=y
BR2_PACKAGE_UTIL_LINUX_LOSETUP=y
```
